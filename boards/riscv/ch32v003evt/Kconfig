## boards/riscv/ch32v003evt/ch32v003evt_defconfig
```kconfig
# SPDX-License-Identifier: Apache-2.0

CONFIG_BOARD_CH32V003EVT=y
CONFIG_SOC_WCH_CH32V003=y
CONFIG_CLOCK_CONTROL=y
CONFIG_PWM=y
CONFIG_SERIAL=y
CONFIG_PINCTRL=y
```

## boards/wch/ch32v003evt/Kconfig.board
```kconfig
# SPDX-License-Identifier: Apache-2.0

config BOARD_CH32V003EVT
	bool "CH32V003EVT"
	depends on SOC_WCH_CH32V003
```

## boards/wch/ch32v003evt/Kconfig.defconfig
```kconfig
# SPDX-License-Identifier: Apache-2.0

config BOARD
	default "ch32v003evt"
	depends on BOARD_CH32V003EVT
```

## boards/wch/ch32v003evt/wch_ch32v003evt_defconfig
```kconfig
# Copyright (c) 2024 Michael Hope
# SPDX-License-Identifier: Apache-2.0

CONFIG_SOC_WCH_CH32V00X_HSE=y
CONFIG_SOC_WCH_CH32V00X_PLL=y
CONFIG_SOC_WCH_CH32V00X_HSE_AS_PLLSRC=y
CONFIG_SOC_WCH_CH32V00X_PLL_AS_SYSCLK=y

CONFIG_CLOCK_CONTROL=y
CONFIG_PINCTRL=y
CONFIG_SERIAL=y
```

## drivers/gpio/Kconfig.ch32v00x
```kconfig
# Copyright (c) 2024 Michael Hope
# SPDX-License-Identifier: Apache-2.0

config GPIO_WCH_GPIO
	default y
	depends on DT_HAS_WCH_GPIO_ENABLED
	bool "WCH CH32V00x GPIO driver"
```

## drivers/pinctrl/Kconfig.wch_afio
```kconfig
# Copyright (c) 2021 Teslabs Engineering S.L.
# SPDX-License-Identifier: Apache-2.0

config PINCTRL_WCH_AFIO
	bool "WCH AFIO pin controller driver"
	default y
	depends on DT_HAS_WCH_AFIO_ENABLED
	help
	  WCH AFIO pin controller driver.
```

## drivers/pwm/Kconfig.ch32v00x
```kconfig
# Copyright (c) 2022, Joep Buruma
# SPDX-License-Identifier: Apache-2.0

config PWM_WCH_GPTM
	bool "WCH General-purpose Timer (GPTM)"
	default y
	depends on DT_HAS_WCH_GPTM_ENABLED
	help
	  PWM driver WCH CH32V00x GPTM such as TIM2 on the CH32V003
```

## drivers/serial/Kconfig.wch_usart
```kconfig
# Copyright (c) 2021 ATL Electronics
# SPDX-License-Identifier: Apache-2.0

config UART_WCH_USART
	bool "CH32V00x USART driver"
	default y
	depends on DT_HAS_WCH_USART_ENABLED
	select SERIAL_HAS_DRIVER
	help
	  This option enables the USART driver for CH32V00x SoC family.
```

## drivers/timer/Kconfig.ch32v00x
```kconfig
# Copyright (c) 2014-2015 Wind River Systems, Inc.
# Copyright (c) 2016 Cadence Design Systems, Inc.
# Copyright (c) 2019 Intel Corp.
# SPDX-License-Identifier: Apache-2.0

config CH32V00X_SYSTICK
	bool "CH32V00X systick timer"
	depends on SOC_WCH_CH32V003
	default y
	depends on DT_HAS_WCH_SYSTICK_ENABLED
```

## dts/bindings/interrupt-controller/wch,pfic.yaml
```yaml
# Copyright (c) 2018 Foundries.io
# SPDX-License-Identifier: Apache-2.0

description: RV32M1 INTMUX IP

compatible: "wch,pfic"

include: [interrupt-controller.yaml, base.yaml]

properties:
  reg:
    required: true

  "#interrupt-cells":
    const: 1

interrupt-cells:
  - irq
```

## dts/bindings/pwm/wch,gptm.yaml
```yaml
# Copyright (c) 2021 Teslabs Engineering S.L.
# SPDX-License-Identifier: Apache-2.0

description: WCH General-purpose Timer (GPTM)

compatible: "wch,gptm"

include: [base.yaml, pwm-controller.yaml]

properties:
  prescaler:
    type: int
    default: 1
    description: Counter prescaler (1 to 65536)

  "#pwm-cells":
    const: 3

pwm-cells:
  - channel
  - period
  - flags
```

## dts/bindings/timer/wch,systick.yaml
```yaml
# Copyright (c) 2021 Espressif Systems (Shanghai) Co., Ltd.
# SPDX-License-Identifier: Apache-2.0

description: Systick

compatible: "wch,systick"

include: base.yaml

properties:
  reg:
    required: true

  interrupts:
    required: true
```

## modules/Kconfig.ch32v00x
```kconfig
# Gecko SDK

# Copyright (c) 2017, Christian Taedcke
# SPDX-License-Identifier: Apache-2.0

config HAS_CH32V00X_HAL
	bool
	depends on SOC_WCH_CH32V003
```

## soc/riscv/wch_ch32v003/Kconfig.defconfig
```kconfig
# RV32M1 SoC RISC-V core default configuration values

# Copyright (c) 2018 Foundries.io Ltd
# SPDX-License-Identifier: Apache-2.0

if SOC_WCH_CH32V003

config SOC
	default "wch_ch32v003"

config NUM_IRQS
	default 32

config SYS_CLOCK_HW_CYCLES_PER_SEC
	default 48000000

endif # SOC_WCH_CH32V003
```

## soc/riscv/wch_ch32v003/Kconfig.soc
```kconfig
# Copyright (c) 2018 Foundries.io Ltd
# SPDX-License-Identifier: Apache-2.0

config SOC_WCH_CH32V003
	bool "WCH CH32V003"
	select RISCV
	select BUILD_OUTPUT_HEX
	select RISCV_ISA_RV32E
	select RISCV_ISA_EXT_ZICSR
	select RISCV_ISA_EXT_ZIFENCEI
	select RISCV_ISA_EXT_C
	select CH32V00X_SYSTICK
	select HAS_CH32V00X_HAL
```

## soc/wch/ch32v00x/Kconfig.soc
```kconfig
# Copyright (c) 2024 Michael Hope
# SPDX-License-Identifier: Apache-2.0

config SOC_SERIES_CH32V00X
	bool

config SOC_CH32V003
	bool
	select SOC_SERIES_CH32V00X

config SOC_SERIES
	default "ch32v00x" if SOC_SERIES_CH32V00X

config SOC
	default "ch32v003" if SOC_CH32V003

config SOC_WCH_CH32V00X_HSI
	bool "Internal 24 MHz high speed RC oscillator (HSI)"
	help
	  Enable the internal 24 MHz RC oscillator at startup.
	  This can then be selected as the main clock reference for the SOC.

config SOC_WCH_CH32V00X_HSE
	bool "External 4..25 MHz oscillator (HSE)"
	help
	  Enable the high speed external oscillator at startup.
	  This can then be selected as the main clock reference for the SOC.

config SOC_WCH_CH32V00X_LSI
	bool "Internal 128 kHz low speed RC oscillator (LSI)"
	help
	  Enable the internal 128 kHz low speed oscillator at startup.

config SOC_WCH_CH32V00X_PLL
	bool "Internal PLL"
	help
	  Enable the interal PLL at startup.
	  This can then be selected as the main clock reference for the SOC.

choice
	prompt "PLL clock source"
	default SOC_WCH_CH32V00X_DEFAULT_AS_PLLSRC
	help
	  Selects which clock to use as PLL clock.

config SOC_WCH_CH32V00X_DEFAULT_AS_PLLSRC
	bool "DEFAULT"
	help
	  This choice will leave the PLL source in its initial state.
	  This can be the default reset state, i.e. HSI as PLLSRC, or a
	  state set by a bootloader.

config SOC_WCH_CH32V00X_HSI_AS_PLLSRC
	bool "HSI"
	depends on SOC_WCH_CH32V00X_HSI

config SOC_WCH_CH32V00X_HSE_AS_PLLSRC
	bool "HSE"
	depends on SOC_WCH_CH32V00X_HSE

endchoice

choice
	prompt "Main clock reference"
	default SOC_WCH_CH32V00X_DEFAULT_AS_SYSCLK
	help
	  Selects which clock to use as the main SYSCLK. Other clocks, such
	  as HCLK, will be derived from SYSCLK.

config SOC_WCH_CH32V00X_DEFAULT_AS_SYSCLK
	bool "DEFAULT"
	help
	  This choice will leave all clocks in their initial state.
	  This can be the default reset state, i.e. HSI with no PLL, or a
	  state set by a bootloader.

config SOC_WCH_CH32V00X_PLL_AS_SYSCLK
	bool "PLL"
	depends on SOC_WCH_CH32V00X_PLL

config SOC_WCH_CH32V00X_HSI_AS_SYSCLK
	bool "HSI"
	depends on SOC_WCH_CH32V00X_HSI

config SOC_WCH_CH32V00X_HSE_AS_SYSCLK
	bool "HSE"
	depends on SOC_WCH_CH32V00X_HSE

endchoice
```
