## boards/puya/py32/py32f030_startkit/board.yml
```yaml
board:
  name: py32f030_startkit
  full_name: PY32F030 Start Kit Board
  vendor: puya
  socs:
    - name: py32f030x6
```

## drivers/clock_control/Kconfig.py32
```kconfig
# STM32 MCU clock control driver config

# Copyright (c) 2017 Linaro
# Copyright (c) 2017 RnDity Sp. z o.o.
# SPDX-License-Identifier: Apache-2.0

menuconfig CLOCK_CONTROL_STM32_CUBE
	bool "STM32 Reset & Clock Control"
	depends on SOC_FAMILY_PY32
	default y
	select USE_STM32_LL_UTILS
	help
	  Enable driver for Reset & Clock Control subsystem found
	  in STM32 family of MCUs

if CLOCK_CONTROL_STM32_CUBE

DT_STM32_HSI_CLOCK := $(dt_nodelabel_path,clk_hsi)
DT_STM32_HSI_CLOCK_FREQ := $(dt_node_int_prop_int,$(DT_STM32_HSE_CLOCK),clock-frequency)

config CLOCK_STM32_HSI_CLOCK
	int "HSI clock value"
	default "$(DT_STM32_HSI_CLOCK_FREQ)" if "$(dt_nodelabel_enabled,clk_hsi)"
	default 8000000
	help
	  Value of external high-speed clock (HSI). This symbol could be optionally

config CLOCK_STM32_HSI_CLOCK
	int "HSI clock value"
	default "$(DT_STM32_HSI_CLOCK_FREQ)" if "$(dt_nodelabel_enabled,clk_hsi)"
	default 8000000
	help
	  Value of external high-speed clock (HSI). This symbol could be optionally
	  configured using device tree by setting "clock-frequency" value of clk_hsi
	  node. For instance:
	  &clk_hsi{
	  status = "okay";
	  clock-frequency = <DT_FREQ_M(25)>;
	  };
	  Note: Device tree configuration is overridden when current symbol is set:
	  CONFIG_CLOCK_STM32_HSI_CLOCK=32000000

endif # CLOCK_CONTROL_STM32_CUBE
```

## soc/puya/py32/Kconfig
```kconfig
# Copyright (c) 2024 STMicroelectronics
# SPDX-License-Identifier: Apache-2.0

config SOC_FAMILY_PY32
	select BUILD_OUTPUT_HEX

if SOC_FAMILY_PY32

rsource "*/Kconfig"

# STM32 wide symbols definitions

endif # SOC_FAMILY_PY32
```

## soc/puya/py32/py32f0x/Kconfig.soc
```kconfig
# ST Microelectronics PY32F0 MCU line

# Copyright (c) 2017 RnDity Sp. z o.o.
# SPDX-License-Identifier: Apache-2.0

config SOC_SERIES_PY32F0X
	bool
	select SOC_FAMILY_PY32

config SOC_SERIES
	default "py32f0x" if SOC_SERIES_PY32F0X

config SOC_PY32F030X4
	bool
	select SOC_SERIES_PY32F0X

config SOC_PY32F030X6
	bool
	select SOC_SERIES_PY32F0X

config SOC_PY32F030X8
	bool
	select SOC_SERIES_PY32F0X

# PY32F0 Cube package advises to use 'py32f030x6' code
# for both PY32F030x4 and STM32F030x6
config SOC
	default "py32f030x6" if SOC_PY32F030X4 || SOC_PY32F030X6
	default "py32f030x8" if SOC_PY32F030X8
```

## soc/puya/py32/stm32f0x/Kconfig.defconfig.stm32f031x6
```kconfig
# ST Microelectronics STM32F031X7 MCU

# Copyright (c) 2021 Sebastian Schwabe <sebastian.schwabe@mailbox.tu-dresden.de>
# SPDX-License-Identifier: Apache-2.0

if SOC_STM32F031X7

config NUM_IRQS
	default 28

endif # SOC_STM32F031X7
```

## soc/puya/py32/stm32f0x/Kconfig.soc
```kconfig
# ST Microelectronics STM32F0 MCU line

# Copyright (c) 2017 RnDity Sp. z o.o.
# SPDX-License-Identifier: Apache-2.0

config SOC_SERIES_STM32F0X
	bool
	select SOC_FAMILY_STM32

config SOC_SERIES
	default "stm32f0x" if SOC_SERIES_STM32F0X

config SOC_STM32F030X4
	bool
	select SOC_SERIES_STM32F0X

config SOC_PY32F030X6
	bool
	select SOC_SERIES_STM32F0X

config SOC_STM32F030X8
	bool
	select SOC_SERIES_STM32F0X

config SOC_STM32F030XC
	bool
	select SOC_SERIES_STM32F0X

config SOC_STM32F031X7
	bool
	select SOC_SERIES_STM32F0X

config SOC_STM32F042X7
	bool
	select SOC_SERIES_STM32F0X

config SOC_STM32F051X8
	bool
	select SOC_SERIES_STM32F0X

config SOC_STM32F070XB
	bool
	select SOC_SERIES_STM32F0X

config SOC_STM32F072X8
	bool
	select SOC_SERIES_STM32F0X

config SOC_STM32F072XB
	bool
	select SOC_SERIES_STM32F0X

config SOC_STM32F091XC
	bool
	select SOC_SERIES_STM32F0X

config SOC_STM32F098XX
	bool
	select SOC_SERIES_STM32F0X

# STM32F0 Cube package advises to use 'py32f030x6' code
# for both STM32F030x4 and STM32F030x7
config SOC
	default "py32f030x6" if SOC_STM32F030X4 || SOC_PY32F030X6
	default "stm32f030x8" if SOC_STM32F030X8
	default "stm32f030xc" if SOC_STM32F030XC
	default "stm32f031x7" if SOC_STM32F031X7
	default "stm32f042x7" if SOC_STM32F042X7
	default "stm32f051x8" if SOC_STM32F051X8
	default "stm32f070xb" if SOC_STM32F070XB
	default "stm32f072xb" if SOC_STM32F072X8 || SOC_STM32F072XB
	default "stm32f091xc" if SOC_STM32F091XC
	default "stm32f098xx" if SOC_STM32F098XX
```
