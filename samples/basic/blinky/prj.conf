## prj.conf
```kconfig
CONFIG_GPIO=y
CONFIG_NO_OPTIMIZATIONS=y
CONFIG_PINCTRL=y
```

## src/main.c
```c
/*
 * Copyright (c) 2016 Intel Corporation
 *
 * SPDX-License-Identifier: Apache-2.0
 */

#include <stdio.h>
#include <zephyr/kernel.h>
#include <zephyr/drivers/gpio.h>

/* 1000 msec = 1 sec */
#define SLEEP_TIME_MS   1000

/* The devicetree node identifier for the "led0" alias. */
#define LED0_NODE DT_ALIAS(led0)

/*
 * A build error on this line means your board is unsupported.
 * See the sample documentation for information on how to fix this.
 */
static const struct gpio_dt_spec led = GPIO_DT_SPEC_GET(LED0_NODE, gpios);

int gret;

int main(void)
{
	int ret;
	bool led_state = true;

	// while(1); // works!

bad:

	if (!gpio_is_ready_dt(&led)) {
		goto bad;
	}

	ret = gpio_pin_configure_dt(&led, GPIO_OUTPUT_ACTIVE);
	if (ret < 0) {
		while(1) {
			gret = ret;
			printf("LED state: %d\n", gret);
		}
	}

	// while(1); // works!

	while (1) {
		ret = gpio_pin_toggle_dt(&led);
		// for (int j = 0; j < 1000000; j++);
		if (ret < 0) {
			while (1) {
				gret = ret;
			}
		}

		led_state = !led_state;
		// printf("LED state: %s\n", led_state ? "ON" : "OFF");
		k_msleep(SLEEP_TIME_MS); // problematic!
	}

	return gret;
}
```
